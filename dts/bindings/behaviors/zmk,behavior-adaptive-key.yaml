## dts/bindings/behaviors/zmk,behavior-adaptive-key.yaml
```yaml
# Copyright (c) 2024 The ZMK Contributors
# SPDX-License-Identifier: MIT

description: Adaptive key behavior

compatible: "zmk,behavior-adaptive-key"

include: zero_param.yaml

properties:
  bindings:
    type: phandle-array
    description: |
      Default binding if no trigger condition is met.
    required: true
  dead-keys:
    type: array
    description: |
      List of key codes that are converted into dead keys.
    default: []
  delete-keycode:
    type: int
    description: |
      Keycode to press when delete-prior is set.

child-binding:
  description: "An adaptive key condition"

  properties:
    bindings:
      type: phandle-array
      required: true
    trigger-keys:
      type: array
      required: true
    max-prior-idle-ms:
      type: int
      default: -1
    min-prior-idle-ms:
      type: int
      default: -1
    delete-prior:
      type: boolean
    strict-modifiers:
      type: boolean
    allow-more-modifiers:
      type: boolean
      description: |
        If true, the last pressed key must have at least the modifiers 
        specified in trigger-keys, but can have additional modifiers.
        Cannot be used with strict-modifiers because it will take precedence.
```
